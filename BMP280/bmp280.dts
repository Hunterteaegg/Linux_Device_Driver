/dts-v1/;
/plugin/;

/ {
		compatible = "brcm,bcm2835";

		fragment@0 {
				target = <&i2c_arm>;
				__overlay__ {
				#address-cells = <1>;
                #size-cells= <0>;	

				bmp280@0 {
								compatible = "My Bosch Sensor,bmp280";
								reg = <0x76>;
								status = "okay";
						};
				};
		};
};


